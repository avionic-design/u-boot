## board/avionic-design/kein-baseboard/Kconfig
```kconfig
if TARGET_KBB

config SYS_BOARD
	string
	default "kein-baseboard"

config SYS_VENDOR
	string
	default "avionic-design"

config SYS_CONFIG_NAME
	string
	default "kein-baseboard"

endif
```

## configs/kein-baseboard_defconfig
```kconfig
CONFIG_ARM=y
CONFIG_TEGRA=y
CONFIG_SPL_DM=y
CONFIG_TEGRA124=y
CONFIG_TARGET_KEIN_BASEBOARD=y
CONFIG_DEFAULT_DEVICE_TREE="tegra124-kein-baseboard"
CONFIG_FIT=y
CONFIG_FIT_SIGNATURE=y
CONFIG_HUSH_PARSER=y
CONFIG_SYS_PROMPT="Tegra124 (kein-baseboard) # "
CONFIG_CMD_BOOTZ=y
# CONFIG_CMD_IMLS is not set
# CONFIG_CMD_FLASH is not set
CONFIG_CMD_MMC=y
CONFIG_CMD_I2C=y
CONFIG_CMD_USB=y
CONFIG_CMD_DFU=y
CONFIG_CMD_USB_MASS_STORAGE=y
# CONFIG_CMD_FPGA is not set
CONFIG_CMD_GPIO=y
CONFIG_CMD_DHCP=y
# CONFIG_CMD_NFS is not set
CONFIG_CMD_PING=y
CONFIG_CMD_EXT2=y
CONFIG_CMD_EXT4=y
CONFIG_CMD_FAT=y
CONFIG_CMD_FS_GENERIC=y
CONFIG_DM_I2C_COMPAT=y
CONFIG_E1000=y
CONFIG_CMD_E1000=y
CONFIG_PCI_TEGRA=y
CONFIG_SYS_NS16550=y
CONFIG_USB=y
CONFIG_DM_USB=y
CONFIG_USB_STORAGE=y
CONFIG_USB_GADGET=y
CONFIG_CI_UDC=y
CONFIG_USB_GADGET_DOWNLOAD=y
CONFIG_G_DNL_MANUFACTURER="NVIDIA"
CONFIG_G_DNL_VENDOR_NUM=0x0955
CONFIG_G_DNL_PRODUCT_NUM=0x701a
```
